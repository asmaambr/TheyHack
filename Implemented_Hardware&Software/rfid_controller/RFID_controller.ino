#include <SPI.h>
#include <MFRC522.h>
#include <ESP32Servo.h>

// ----- RFID Pins -----
#define SS_PIN     2
#define RST_PIN    35
#define SPI_MOSI   18
#define SPI_SCK    4
#define SPI_MISO   17

// ----- Hardware -----
#define BUZZER_PIN 19
#define SERVO_PIN  26
#define GREEN_LED  21
#define RED_LED    14
#define SMOKE_PIN  34  // Smoke detector pin

MFRC522 rfid(SS_PIN, RST_PIN);
Servo doorServo;

int invalidCardCount = 0;
unsigned long blockUntilTime = 0;
bool isSystemBlocked = false;

void setup() {
  Serial.begin(9600);
  delay(1000);

  // Hardware Init
  pinMode(BUZZER_PIN, OUTPUT);
  pinMode(GREEN_LED, OUTPUT);
  pinMode(RED_LED, OUTPUT);
  pinMode(SMOKE_PIN, INPUT);  // Set smoke detector pin as input

  // RFID Init
  SPI.begin(SPI_SCK, SPI_MISO, SPI_MOSI, SS_PIN);
  rfid.PCD_Init();

  // Servo Init - IMPORTANT: Initialize servo after other hardware
  doorServo.attach(SERVO_PIN);
  doorServo.write(90);  // Initial closed position (90 degrees like in working code)
  
  Serial.println("RFID system ready. Scan a card.");
}

void loop() {
  // Check smoke detector first
  int smokeLevel = analogRead(SMOKE_PIN);
  if (smokeLevel > 2000) {
    // Activate warning for smoke detection - very danger voice
    tone(BUZZER_PIN, 2500);  // Higher frequency for urgent alert
    digitalWrite(RED_LED, !digitalRead(RED_LED));  // Make the red LED flash
  } else {
    // If no smoke detected and no other buzzer active, ensure buzzer is off
    if (!isSystemBlocked && invalidCardCount < 3) {
      noTone(BUZZER_PIN);
    }
    
    // Only turn off red LED if no other function is using it
    if (!isSystemBlocked && invalidCardCount == 0) {
      digitalWrite(RED_LED, LOW);
    }
  }

  if (isSystemBlocked && millis() < blockUntilTime) {
    delay(100); return;
  } else if (isSystemBlocked) {
    isSystemBlocked = false;
    Serial.println("System unblocked.");
  }

  if (!rfid.PICC_IsNewCardPresent() || !rfid.PICC_ReadCardSerial()) {
    delay(100);
    return;
  }

  String cardUID = "";
  for (byte i = 0; i < rfid.uid.size; i++) {
    if (rfid.uid.uidByte[i] < 0x10) cardUID += "0";
    cardUID += String(rfid.uid.uidByte[i], HEX);
    if (i < rfid.uid.size - 1) cardUID += ":";
  }

  Serial.print("Card UID: ");
  Serial.println(cardUID);

  if (cardUID == "a3:d8:59:fe") {
    Serial.println("Valid card detected.");
    invalidCardCount = 0;

    digitalWrite(GREEN_LED, HIGH);
    digitalWrite(RED_LED, LOW);

    tone(BUZZER_PIN, 880, 200); delay(250);
    tone(BUZZER_PIN, 988, 200); delay(250);
    tone(BUZZER_PIN, 1046, 300); delay(350);
    noTone(BUZZER_PIN);

    // ----- SERVO CONTROL (COPIED FROM WORKING CODE) -----
    // Move servo to open the door
    Serial.println("Servo is turning to open the door...");
    doorServo.write(90);  // Open position (same as in working code)
    delay(2000);        // Wait 2 seconds while door is open
    
    Serial.println("Servo is turning to close the door...");
    doorServo.attach(SERVO_PIN);  // Re-attach servo before moving it (from working code)
    delay(800);                   // Delay from working code
    doorServo.write(-90);         // Closed position (from working code)
    
    digitalWrite(GREEN_LED, LOW);

    Serial.println("Access Granted: " + cardUID);
  } else {
    Serial.println("Invalid card.");
    invalidCardCount++;

    digitalWrite(RED_LED, HIGH);
    digitalWrite(GREEN_LED, LOW);

    Serial.println("Invalid UID: " + cardUID);

    if (invalidCardCount >= 3) {
      Serial.println("SECURITY ALERT: System blocked for 60s.");
      Serial.println("System Blocked after 3 invalid attempts");

      blockUntilTime = millis() + 60000;
      isSystemBlocked = true;

unsigned long buzzerStartTime = millis();
      while (millis() - buzzerStartTime < 60000) {
        // Check smoke during the blocking period
        int currentSmokeLevel = analogRead(SMOKE_PIN);
        if (currentSmokeLevel > 2000) {
          tone(BUZZER_PIN, 2500);  // Higher frequency for urgent smoke alert
        } else {
          tone(BUZZER_PIN, 2000);  // Regular security alarm
        }
        digitalWrite(RED_LED, HIGH); delay(250);
        digitalWrite(RED_LED, LOW); delay(250);
      }
      noTone(BUZZER_PIN);
      invalidCardCount = 0;
    } else {
      tone(BUZZER_PIN, 1000, 500); delay(500);
      noTone(BUZZER_PIN);
    }
    delay(1000);
    digitalWrite(RED_LED, LOW);
  }

  rfid.PICC_HaltA();
  rfid.PCD_StopCrypto1();

  delay(3000);
}